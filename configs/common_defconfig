## configs/common_defconfig
```kconfig
HakiOS common configuration
Shared by every supported device
CONFIG_ARM64=y
CONFIG_PAGE_SIZE_4K=y

CONFIG_HAKIOS=y
CONFIG_HAKIOS_DEBUG=y
CONFIG_HAKIOS_LOG=y

CONFIG_HAKIOS_LOADER=y
CONFIG_HAKIOS_DEVICE_TREE=y
CONFIG_HAKIOS_BOOTARGS=y

CONFIG_HAKIOS_CONSOLE=y
CONFIG_HAKIOS_EARLY_LOG=y

CONFIG_HAKIOS_CPU=y
CONFIG_HAKIOS_TIMER=y
CONFIG_HAKIOS_MM=y
CONFIG_HAKIOS_MMU=y
```
